## components/app_wake_detection/Kconfig
```kconfig
menu "唤醒词服务"

    config WAKE_WORD_ENABLED
        bool "启用语音唤醒服务"
        default y
        help
            启用 ESP32-P4 上的 ES8311 麦克风和中文 MultiNet 语音唤醒服务。

    config WAKE_WORD_MN_THRESHOLD
        float "MultiNet 唤醒阈值"
        default 0.60
        range 0.10 0.99
        help
            “你好小飞”命令词的识别阈值。数值越高误唤醒越少，但需要更清晰地说出命令词。

    config WAKE_WORD_COMMAND_TIMEOUT_MS
        int "命令识别超时时间（毫秒）"
        default 6000
        range 1000 30000
        help
            MultiNet 单次识别窗口的超时时间。

endmenu
```

## components/audio_driver/Kconfig
```kconfig
menu "板级音频驱动"

    config WAKE_WORD_MIC_GAIN_DB
        int "ES8311 麦克风增益（dB）"
        default 24
        range 0 42
        help
            ES8311 ADC 麦克风输入增益。该参数属于板级音频驱动，供唤醒词
            和 AI 对话共享同一套麦克风增益配置。

    config AUDIO_DRIVER_SPEAKER_VOLUME
        int "ES8311 扬声器音量（0-100）"
        range 0 100
        default 100
        help
            设备启动时写入 ES8311 DAC 的输出音量，当前产品要求设置为最大值。

endmenu
```

## components/call_service/Kconfig
```kconfig
menu "Device audio/video calls"
    config CALL_VIDEO_WIDTH
        int "H264 width (must match the selected CSI sensor mode)"
        default 800
        range 16 1920
    config CALL_VIDEO_HEIGHT
        int "H264 height (must match the selected CSI sensor mode)"
        default 1280
        range 16 1920
    config CALL_VIDEO_FPS
        int "Published video FPS"
        default 15
        range 1 30
    config CALL_SPEAKER_VOLUME
        int "Call speaker volume"
        default 65
        range 0 100
endmenu
```

## components/cloud_gateway/Kconfig
```kconfig
menu "Cloud gateway"
    config CLOUD_GATEWAY_SERVER_URL
        string "Default backend HTTPS origin"
        default "https://iot.xingnian.vip"
    config CLOUD_GATEWAY_ALLOW_INSECURE
        bool "Allow HTTP/WS for local development"
        default n
        help
            Only enable for a trusted local development network.
            Production connections verify TLS using the ESP certificate bundle.
endmenu
```

## components/svc_backend_connector/Kconfig
```kconfig
menu "星念后台连接器配置"

config BACKEND_PAIRING_URL
    string "后台配对 WebSocket 地址"
    default "wss://iot.xingnian.vip/ws/device/pair"
    help
        配对流程使用的后台 WebSocket 地址。正式连接器会从该地址提取服务器根地址，
        并使用同一个根地址建立正式设备连接。

endmenu
```

## components/svc_backend_pairing/Kconfig
```kconfig
menu "Backend Pairing Configuration"

    config BACKEND_PAIRING_URL
        string "Backend Pairing WebSocket URL"
        default "wss://iot.xingnian.vip/ws/device/pair"
        help
            后台配对服务器的WebSocket地址
            格式：wss://host/ws/device/pair
            例如：wss://ai-server.example.com/ws/device/pair

    config BACKEND_PAIRING_TIMEOUT_MS
        int "Pairing Timeout (ms)"
        default 300000
        range 30000 600000
        help
            配对超时时间（毫秒）
            默认：300000 (5分钟)

endmenu
```

## components/svc_coze/Kconfig
```kconfig
menu "Coze 直连 AI 应用"

    config COZE_APP_BOT_ID
        string "Coze Bot ID"
        default "7699765325453639731"
        help
            Coze 应用的 Bot ID。

    config COZE_APP_ACCESS_TOKEN
        string "Coze access token"
        default ""
        help
            Coze PAT、OAuth 或 JWT bearer token。正式值写入本地 sdkconfig，
            不要把访问令牌写入业务源码或提交到版本库。

    config COZE_APP_USER_ID
        string "Coze user ID"
        default "p4c5-device"
        help
            用于保持 Coze 会话身份稳定的设备用户 ID。

    config AI_DIALOG_VERBOSE_STATS
        bool "Enable periodic audio pipeline statistics"
        default n

    config AI_DIALOG_VAD_MODE
        int "WebRTC VAD aggressiveness"
        range 0 4
        default 3

    config AI_DIALOG_ENABLE_PLAYBACK_VAD
        bool "启用播放期间本地 VAD 打断"
        default n
        help
            启用后，用户在播放 Coze 回复期间说话时，本地 VAD 可以打断当前播放。
            默认关闭，避免扬声器回声被识别为用户语音而造成错误打断。

    config AUDIO_DRIVER_SPEAKER_VOLUME
        int "ES8311 speaker volume (0-100)"
        range 0 100
        default 100

    config AI_DIALOG_TAIL_SILENCE_MS
        int "End a turn after silence (ms)"
        range 400 2000
        default 800

    config AI_DIALOG_NO_SPEECH_MS
        int "Exit listening when no speech starts (ms)"
        range 3000 15000
        default 5000

    config AI_DIALOG_MAX_TURN_MS
        int "Maximum speech turn (ms)"
        range 5000 30000
        default 15000

    config AI_DIALOG_REPLY_TIMEOUT_MS
        int "First audio timeout after commit (ms)"
        range 5000 60000
        default 10000

endmenu
```

## components/voice_ai_service/Kconfig
```kconfig
menu "AI voice turn and playback"
    choice VOICE_AI_BACKEND
        prompt "AI backend"
        default VOICE_AI_BACKEND_CLOUD
        help
            Select the application-layer AI backend. The generated esp_coze
            component is never modified by this choice.

        config VOICE_AI_BACKEND_CLOUD
            bool "Cloud gateway AI"

        config VOICE_AI_BACKEND_COZE_DIRECT
            bool "Direct Coze connection"
    endchoice

    config VOICE_AI_COZE_BOT_ID
        string "Coze Bot ID"
        depends on VOICE_AI_BACKEND_COZE_DIRECT
        default "7699765325453639731"
        help
            Bot ID used by the direct Coze application backend.

    config VOICE_AI_COZE_ACCESS_TOKEN
        string "Coze access token"
        depends on VOICE_AI_BACKEND_COZE_DIRECT
        default "sat_iCmHvwLS9yqGVX7HasVAIcB9lH0TAlKf5tuNp44G3kesp0Xv01rYjGuS1Td8uKXL"
        help
            PAT, OAuth or JWT bearer token. Keep the value in local sdkconfig;
            do not commit sdkconfig or put the token into source files.

    config VOICE_AI_COZE_USER_ID
        string "Coze user ID"
        depends on VOICE_AI_BACKEND_COZE_DIRECT
        default "p4c5-device"
        help
            Stable user ID used to keep the Coze conversation identity.

    config VOICE_AI_VERBOSE_STATS
        bool "Enable periodic audio pipeline statistics"
        default n
        help
            Print five-second audio throughput, queue and stack statistics.
            Keep disabled during normal operation to reduce serial log volume.

    config VOICE_AI_VAD_MODE
        int "WebRTC VAD aggressiveness (higher rejects more noise)"
        range 0 4
        default 3
    config VOICE_AI_SPEAKER_VOLUME
        int "Speaker volume (0-100)"
        range 0 100
        default 65
    config VOICE_AI_SELF_TEST
        bool "Play PCM and Opus diagnostic tones at boot"
        default n
        help
            Before microphone/cloud startup, play two short low-amplitude tones.
            First PCM, then locally encoded/decoded Opus. No network is used.
    config VOICE_AI_TAIL_SILENCE_MS
        int "End a turn after silence (ms)"
        range 400 2000
        default 800
    config VOICE_AI_NO_SPEECH_MS
        int "Exit listening when no speech starts (ms)"
        range 3000 15000
        default 5000
    config VOICE_AI_MAX_TURN_MS
        int "Maximum speech turn (ms)"
        range 5000 30000
        default 15000
    config VOICE_AI_REPLY_TIMEOUT_MS
        int "First audio timeout after commit (ms)"
        range 5000 60000
        default 10000
endmenu
```

## components/voice_service/Kconfig
```kconfig
menu "语音服务"

    config VOICE_SERVICE_ENABLED
        bool "启用语音唤醒服务"
        default y
        help
            启用 ESP32-P4 上的 ES8311 麦克风和中文 MultiNet 语音唤醒服务。

    config VOICE_SERVICE_MN_THRESHOLD
        float "MultiNet 唤醒阈值"
        default 0.60
        range 0.10 0.99
        help
            “你好小飞”命令词的识别阈值。数值越高误唤醒越少，但需要更清晰地说出命令词。

    config VOICE_SERVICE_COMMAND_TIMEOUT_MS
        int "命令识别超时时间（毫秒）"
        default 6000
        range 1000 30000
        help
            MultiNet 单次识别窗口的超时时间。

    config VOICE_SERVICE_MIC_GAIN_DB
        int "ES8311 麦克风增益（dB）"
        default 24
        range 0 42
        help
            ES8311 ADC 麦克风输入增益。开发板官方录音示例默认提供 24 dB
            选项；语音唤醒组件采用相同的 24 dB 作为默认值，并允许业务工程
            在 menuconfig 中按实际麦克风声压级调整。

endmenu
```

## components/wifi_provisioning/Kconfig
```kconfig
menu "Wi-Fi 网页配网组件"

    config WIFI_PROVISIONING_AP_SSID
        string "配网热点名称"
        default "FengFeifei-AI"
        help
            设备启动后始终开启的 SoftAP 名称。手机连接该热点后访问
            192.168.4.1 即可打开配网页面。

    config WIFI_PROVISIONING_AP_PASSWORD
        string "配网热点密码"
        default "12345678"
        help
            SoftAP 密码。留空表示开放热点；非空时必须至少八个字符，否则
            ESP-IDF Wi-Fi 驱动会拒绝启动热点。

    config WIFI_PROVISIONING_AP_CHANNEL
        int "配网热点初始信道"
        range 1 13
        default 1
        help
            AP+STA 模式连接路由器后，SoftAP 会自动跟随目标路由器信道。

    config WIFI_PROVISIONING_AP_MAX_CONNECTION
        int "配网热点最大客户端数"
        range 1 8
        default 4

    config WIFI_PROVISIONING_HTTP_PORT
        int "配网网页 HTTP 端口"
        range 1 65535
        default 80

    choice WIFI_PROVISIONING_AUTH_THRESHOLD
        prompt "STA 允许的最低认证方式"
        default WIFI_PROVISIONING_AUTH_WPA2_PSK
        help
            正式产品默认拒绝 WEP 和仅 WPA 网络；需要连接开放网络时选择
            OPEN。网页仍会显示扫描到的全部网络。

        config WIFI_PROVISIONING_AUTH_OPEN
            bool "OPEN"

        config WIFI_PROVISIONING_AUTH_WPA2_PSK
            bool "WPA2-PSK"

        config WIFI_PROVISIONING_AUTH_WPA2_WPA3_PSK
            bool "WPA2/WPA3-PSK"
    endchoice

endmenu
```

## main/Kconfig.projbuild
```kconfig
menu "P4 + C5 网络配置"

    config P4_C5_WIFI_SSID
        string "Wi-Fi 名称（SSID）"
        default "myssid"
        help
            ESP32-P4 通过 ESP32-C5 无线协处理器连接的 2.4 GHz 无线网络名称。

    config P4_C5_WIFI_PASSWORD
        string "Wi-Fi 密码"
        default "mypassword"
        help
            无线网络密码。串口日志只打印 SSID，不打印本字段，避免泄露凭据。

    config P4_C5_WIFI_INITIAL_RETRY_COUNT
        int "首次连接最大重试次数"
        range 1 100
        default 8
        help
            首次启动等待达到该次数后，p4_c5_wifi_start() 返回 ESP_FAIL，
            但后台自动重连定时器仍会继续工作，不会永久停止网络恢复。

    config P4_C5_WIFI_RECONNECT_MAX_DELAY_MS
        int "自动重连最大间隔（毫秒）"
        range 1000 60000
        default 10000
        help
            连续断线时采用线性退避，该数值限制最长等待时间，避免高频重连。

    config P4_C5_WIFI_GATEWAY_PING_COUNT
        int "联网后网关 Ping 次数"
        range 0 20
        default 4
        help
            DHCP 成功后向网关发送指定次数 ICMP 请求，用于验证
            P4、SDIO、C5、接入点之间的数据路径。设置为 0 可关闭测试。

    choice P4_C5_WIFI_AUTH_THRESHOLD
        prompt "允许连接的最低 Wi-Fi 认证方式"
        default P4_C5_WIFI_AUTH_WPA2_PSK
        help
            扫描和关联时接受的最低安全等级。正式产品建议保持 WPA2 或更高。

        config P4_C5_WIFI_AUTH_OPEN
            bool "开放网络"

        config P4_C5_WIFI_AUTH_WPA2_PSK
            bool "WPA2-PSK"

        config P4_C5_WIFI_AUTH_WPA2_WPA3_PSK
            bool "WPA2/WPA3-PSK"
    endchoice

endmenu
```

## sdkconfig.defaults
```kconfig
CONFIG_IDF_TARGET="esp32p4"
CONFIG_MBEDTLS_CERTIFICATE_BUNDLE=y
CONFIG_SLAVE_IDF_TARGET_ESP32C5=y
CONFIG_ESP_WIFI_REMOTE_LIBRARY_HOSTED=y
CONFIG_ESP_HOSTED_P4_DEV_BOARD_NONE=y
CONFIG_ESP_HOSTED_SDIO_HOST_INTERFACE=y
CONFIG_ESP_HOSTED_SDIO_RESET_ACTIVE_HIGH=y
CONFIG_ESP_HOSTED_SDIO_OPTIMIZATION_RX_STREAMING_MODE=y
CONFIG_ESP_HOSTED_SDIO_SLOT_1=y
CONFIG_ESP_HOSTED_SDIO_4_BIT_BUS=y
CONFIG_ESP_HOSTED_SDIO_CLOCK_FREQ_KHZ=40000
CONFIG_ESP_HOSTED_PRIV_SDIO_PIN_CMD_SLOT_1=19
CONFIG_ESP_HOSTED_PRIV_SDIO_PIN_CLK_SLOT_1=18
CONFIG_ESP_HOSTED_PRIV_SDIO_PIN_D0_SLOT_1=14
CONFIG_ESP_HOSTED_PRIV_SDIO_PIN_D1_4BIT_BUS_SLOT_1=15
CONFIG_ESP_HOSTED_PRIV_SDIO_PIN_D2_4BIT_BUS_SLOT_1=16
CONFIG_ESP_HOSTED_PRIV_SDIO_PIN_D3_4BIT_BUS_SLOT_1=17
CONFIG_ESP_HOSTED_SDIO_GPIO_RESET_SLAVE=54

# ESP-SR 中文 MultiNet7 模型和模型分区配置。
CONFIG_PARTITION_TABLE_CUSTOM=y
CONFIG_PARTITION_TABLE_CUSTOM_FILENAME="partitions.csv"
CONFIG_PARTITION_TABLE_FILENAME="partitions.csv"
CONFIG_PARTITION_TABLE_OFFSET=0x8000
CONFIG_ESPTOOLPY_FLASHSIZE_16MB=y
CONFIG_SR_MN_CN_MULTINET7_QUANT=y

# ESP32-P4 语音算法需要外部 PSRAM 保存模型和运行时缓冲区。
CONFIG_SPIRAM=y
CONFIG_SPIRAM_SPEED_200M=y
CONFIG_CACHE_L2_CACHE_256KB=y
CONFIG_CACHE_L2_CACHE_LINE_128B=y
CONFIG_WAKE_WORD_ENABLED=y
CONFIG_WAKE_WORD_MN_THRESHOLD=0.60
CONFIG_WAKE_WORD_COMMAND_TIMEOUT_MS=6000
CONFIG_WAKE_WORD_MIC_GAIN_DB=24
CONFIG_AUDIO_DRIVER_SPEAKER_VOLUME=100

# 视频上行使用厂家 ESP32-P4-WIFI6-DB BSP 的共享 I2C 总线和 OV5647 摄像头。
CONFIG_BSP_I2C_NUM=1
CONFIG_BSP_I2C_FAST_MODE=y
CONFIG_BSP_I2C_CLK_SPEED_HZ=400000
CONFIG_CAMERA_OV5647=y
CONFIG_CAMERA_OV5647_MIPI_RAW8_800X1280_50FPS=y
CONFIG_CAMERA_OV5647_MIPI_RAW8_800X800_50FPS=n
CONFIG_CAMERA_OV5647_MIPI_DEFAULT_FMT_RAW8_800X1280_50FPS=y
CONFIG_CAMERA_OV5647_MIPI_DEFAULT_FMT_RAW8_800X800_50FPS=n
CONFIG_CAM_CTRL_SPI_ENABLE=n
CONFIG_ESP_VIDEO_ENABLE_ISP_PIPELINE_CONTROLLER=y
CONFIG_IDF_EXPERIMENTAL_FEATURES=y
```
